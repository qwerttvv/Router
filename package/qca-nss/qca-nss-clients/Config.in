## package/qca-nss/qca-nss-clients/Config.in
```kconfig
config NSS_NLGRE_REDIR_ENABLE
	bool
	depends on PACKAGE_kmod-qca-nss-drv-netlink
	default y if NSS_DRV_GRE_REDIR_ENABLE
	help
	  NSS Netlink GRE Redirect support. This is automatically
	  selected when NSS GRE Redirect driver is enabled.

config NSS_NLQRFS_ENABLE
	bool
	depends on PACKAGE_kmod-qca-nss-drv-netlink
	default y if NSS_DRV_QRFS_ENABLE
	help
	  NSS Netlink QRFS support. This is automatically
	  selected when NSS QRFS driver is enabled.

config NSS_NLUDP_ST_ENABLE
	bool
	depends on PACKAGE_kmod-qca-nss-drv-netlink
	default y if NSS_DRV_UDP_ST_ENABLE
	help
	  NSS Netlink UDP Speed Test support. This is automatically
	  selected when NSS UDP Speed Test driver is enabled.

config NSS_NLLSO_RX
	bool
	depends on PACKAGE_kmod-qca-nss-drv-netlink
	default y if NSS_DRV_LSO_RX_ENABLE
	help
	  NSS Netlink IP LSO RX support. This is automatically
	  selected when NSS IP LSO RX driver is enabled.
```

## package/qca-nss/qca-nss-drv/Config.in
```kconfig
menu "Configuration"
	depends on PACKAGE_kmod-qca-nss-drv

config NSS_DRV_BRIDGE_ENABLE
	bool "Enable BRIDGE"
	depends on TARGET_qualcommax_ipq807x || TARGET_qualcommax_ipq60xx

config NSS_DRV_CRYPTO_ENABLE
	bool "Enable CRYPTO"
	depends on TARGET_qualcommax_ipq807x || TARGET_qualcommax_ipq60xx

config NSS_DRV_GRE_ENABLE
	bool "Enable GRE"

config NSS_DRV_GRE_REDIR_ENABLE
	bool "Enable GRE_REDIR"
	depends on NSS_DRV_GRE_ENABLE

config NSS_DRV_GRE_TUNNEL_ENABLE
	bool "Enable GRE_TUNNEL"
	depends on NSS_DRV_GRE_ENABLE

config NSS_DRV_IGS_ENABLE
	bool "Enable IGS"

config NSS_DRV_IPV4_REASM_ENABLE
	bool "Enable IPV4_REASM"

config NSS_DRV_IPV6_ENABLE
	bool "Enable IPV6"

config NSS_DRV_IPV6_REASM_ENABLE
	bool "Enable IPV6_REASM"
	depends on NSS_DRV_IPV6_ENABLE

config NSS_DRV_L2TP_ENABLE
	bool "Enable L2TP"

config NSS_DRV_LAG_ENABLE
	bool "Enable LAG"
	depends on TARGET_qualcommax_ipq807x || TARGET_qualcommax_ipq60xx

config NSS_DRV_LSO_RX_ENABLE
	bool "Enable LSO RX"

config NSS_DRV_MAPT_ENABLE
	bool "Enable MAPT"

config NSS_DRV_MATCH_ENABLE
	bool "Enable MATCH"

config NSS_DRV_MIRROR_ENABLE
	bool "Enable MIRROR"

config NSS_DRV_PPPOE_ENABLE
	bool "Enable PPPOE"

config NSS_DRV_PPTP_ENABLE
	bool "Enable PPTP"

config NSS_DRV_QRFS_ENABLE
	bool "Enable QRFS"
	depends on TARGET_qualcommax_ipq807x

config NSS_DRV_RMNET_ENABLE
	bool "Enable RMNET"
	depends on TARGET_qualcommax_ipq807x || TARGET_qualcommax_ipq50xx

config NSS_DRV_SHAPER_ENABLE
	bool "Enable SHAPER"

config NSS_DRV_SJACK_ENABLE
	bool "Enable SJACK"

config NSS_DRV_TRUSTSEC_ENABLE
	bool "Enable TRUSTSEC"

config NSS_DRV_TRUSTSEC_RX_ENABLE
	bool "Enable TRUSTSEC_RX"
	depends on NSS_DRV_TRUSTSEC_ENABLE

config NSS_DRV_TUN6RD_ENABLE
	bool "Enable TUN6RD"

config NSS_DRV_TUNIPIP6_ENABLE
	bool "Enable TUNIPIP6"

config NSS_DRV_UDP_ST_ENABLE
	bool "Enable UDP Speedtest"
	depends on TARGET_qualcommax_ipq807x || TARGET_qualcommax_ipq50xx

config NSS_DRV_VIRT_IF_ENABLE
	bool "Enable VIRT_IF"

config NSS_DRV_VLAN_ENABLE
	bool "Enable VLAN"
	depends on TARGET_qualcommax_ipq807x || TARGET_qualcommax_ipq60xx

config NSS_DRV_VXLAN_ENABLE
	bool "Enable VXLAN"

config NSS_DRV_WIFIOFFLOAD_ENABLE
	bool "Enable WIFI"

config NSS_DRV_WIFI_EXT_VDEV_ENABLE
	bool "Enable WIFI EXT VDEV"
	depends on NSS_DRV_WIFIOFFLOAD_ENABLE

config NSS_DRV_WIFI_MESH_ENABLE
	bool "Enable WIFI MESH"
	depends on NSS_DRV_WIFIOFFLOAD_ENABLE

endmenu
```
